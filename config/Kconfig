## config/Kconfig
```kconfig
#
# Copyright (c) 2022 The ZMK Contributors
# SPDX-License-Identifier: MIT
#

config BOARD_CORNE_LEFT
    bool

config BOARD_CORNE_RIGHT
    bool
```

## config/boards/arm/corne/Kconfig.board
```kconfig
#
# Copyright (c) 2022 Darryl deHaan
# SPDX-License-Identifier: MIT
#

config BOARD_CORNE_LEFT
    bool "corne left"
    depends on SOC_NRF52840_QIAA


config BOARD_CORNE_RIGHT
    bool "corne right"
    depends on SOC_NRF52840_QIAA
```

## config/boards/arm/corne/Kconfig.defconfig
```kconfig
#
# Copyright (c) 2022 Darryl deHaan
# SPDX-License-Identifier: MIT
#

if BOARD_CORNE_LEFT

config ZMK_KEYBOARD_NAME
    default "Corne"

config ZMK_SPLIT_ROLE_CENTRAL
    default y

endif # BOARD_CORNE_LEFT


if BOARD_CORNE_LEFT || BOARD_CORNE_RIGHT

config BOARD
    default "corne"

config ZMK_SPLIT
    default y

config BT_CTLR
    default BT

if USB

config USB_NRFX
    default y

config USB_DEVICE_STACK
    default y

endif # USB

if ZMK_DISPLAY

config I2C
    default y

config SSD1306
    default y

choice ZMK_DISPLAY_WORK_QUEUE
    default ZMK_DISPLAY_WORK_QUEUE_DEDICATED
endchoice

endif

if SSD1306

config LV_Z_VDB_SIZE
    default 64

config LV_DPI_DEF
    default 148

config LV_Z_BITS_PER_PIXEL
    default 1

choice LV_COLOR_DEPTH
    default LV_COLOR_DEPTH_1
endchoice

endif

endif # BOARD_CORNE_LEFT || BOARD_CORNE_RIGHT
```

## config/boards/shields/nice_view_adapter/Kconfig.shield
```kconfig
config SHIELD_NICE_VIEW_ADAPTER
    def_bool $(shields_list_contains,nice_view_adapter)
```
